## firmware/main/Kconfig.projbuild
```kconfig
menu "BYAI hardware tests"

    config BYAI_LCD_COLOR_BARS_TEST
        bool "Enable looping LCD TV color bars"
        default n
        help
            Draw eight RGB565 color bars and rotate the color order once per
            second. Disable to leave the display available for the application.

    config BYAI_POWER_BASIC_TEST
        bool "Enable BQ25890 basic power test"
        default n
        help
            Poll BQ25890 identity, power and fault status once per second.
            USB supply without a battery is the initial validation condition.
            Charging settings and the INT GPIO retain their existing configuration.

    config BYAI_POWER_DEBUG_DISABLE_WATCHDOG
        bool "Debug only: disable BQ25890 I2C watchdog for ADC"
        depends on BYAI_POWER_BASIC_TEST
        default n
        help
            ADC test initialization clears REG07 WATCHDOG bits and verifies
            readback, preserving other bits including the charging safety timer.
            With the watchdog disabled, register settings stay active during
            debugger pauses and software stalls. Takes effect with ADC enabled.
            The watchdog stays disabled until explicit configuration or chip power-on reset,
            including after this option is disabled in a later firmware build.
            For production, implement watchdog servicing and a battery charging
            policy.

    config BYAI_POWER_ADC_TEST
        bool "Enable BQ25890 VBUS/SYS ADC test"
        depends on BYAI_POWER_BASIC_TEST && BYAI_POWER_DEBUG_DISABLE_WATCHDOG
        default n
        help
            Use 1.2-second continuous ADC windows and log VBUS/SYS in millivolts.
            Clears continuous mode after each window and verifies readback.
            Requires explicit debug watchdog disable; initialization verifies
            it before sampling. The watchdog stays disabled during conversions.
            Enters host mode; other power/charging control bits are preserved.
            Compare with a multimeter using USB supply without a battery.

    config BYAI_POWER_STATE_FAULT_TEST
        bool "Diagnostic only: inject power state failures instead of sampling"
        depends on BYAI_POWER_BASIC_TEST
        default n
        help
            Replaces the normal power collector with a one-shot Q4/Q5 software
            injection suite, including a real 10-second timeout checked by a
            separate task. Voltage fields come from software-defined synthetic
            samples. Injection uses the state interface while BQ25890 devices
            and charging registers retain their existing state. Logs pass/fail
            and then stops. Disable and flash normal firmware to resume sampling.

    config BYAI_AUDIO_SINE_TEST
        bool "Enable WM8978 1 kHz sine-wave headphone output"
        default n
        help
            Plays a locally generated 1 kHz sine wave through the WM8978
            headphone outputs (LOUT1/ROUT1). The sample data is produced on
            the ESP32-S3: no stored audio file, no microphone capture and no
            recording buffer. Format is 48 kHz / 16-bit / stereo, and the tone
            is 48 samples per period, so the transmit buffer holds whole
            periods only (20 periods, 3840 bytes) and the wrap point has no
            phase discontinuity.

            WM8978 is configured over the shared board I2C bus (GPIO38/39) at
            7-bit address 0x1A; MODE must be strapped low for 2-wire control.
            Codec registers are written before I2S is enabled, because the
            opposite order leaves the control port unresponsive. I2S uses
            MCLK=GPIO17 (256*fs = 12.288 MHz), BCLK=GPIO6, WS=GPIO7 and
            DACDAT=GPIO16; ADCDAT is not driven in this TX-only path.

            Enabling this takes precedence over the display and power tests:
            app_main skips SPI/display init and the power collector so the
            audio task owns the I2C bus alone. Disable the BYAI power options
            when using it, since they would otherwise contend for the bus.

            Diagnostic only. A successful write sequence does not prove
            audible output; MCLK/BCLK/WS and the analog path still need
            hardware measurement.

endmenu
```
